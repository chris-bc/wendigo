## esp32/main/Kconfig.projbuild
```kconfig
menu "Wendigo Configuration"

    config DEFAULT_HOP_MILLIS
        int "Default dwell time for WiFi when channel hopping (milliseconds)"
        default 500
        help
            This specifies the default length of time Wendigo should remain on a
            wireless channel before progressing to the next channel when
            channel hopping is enabled.

    config BLE_SCAN_SECONDS
        int "Number of seconds for a single cycle of BLE scanning"
        default 10
        help
            This specifies the duration of BLE scanning. When this duration has passed
            Wendigo might dispatch a status update to Flipper Zero and restart scanning continually until
            scanning is deactivated. It's also possible data will be sent to Flipper Zero as soon as it is available.
            Who knows? :) But apart from a negligible performance impact this
            setting is mostly concerned with how frequently you would like a status update.
    
    config BT_SCAN_DURATION
        int "Duration of a Bluetooth Classic scan cycle"
        default 16
        help
            This specifies the duration of Bluetooth Classic Discovery, in 1.28-second units.
            When this duration has passed Gravity will display a status message and restart
            scanning continually until scanning is deactivated; apart from a negligible
            performance impact this setting is mostly concerned with how frequentnly you would
            like a status update.
            Developer's recommendation: 0x10 (16).
    
    config DELAY_AFTER_DEVICE_DISPLAYED
        int "Delay before a device is re-reported in Interactive Mode"
        default 2000
        help
            This specifies the minimum time that must elapse before a device that has been
            reported in scanning will be reported again in Interactive Mode. While this may
            reduce the quality of scan results, without this setting the interactive display
            is immediately crowded by multiple reports of the same device.

    config DECODE_UUIDS
        bool "Include Bluetooth UUID Dictionary"
        default y
        help
            Bluetooth services are represented by service UUIDs. Select this option to include
            Bluetooth assigned numbers details, allowing UUIDs to be translated into plain text.

    config DEBUG
        bool "Enable debugging output"
        default y
        help
            This option displays additional logging information to aid in the identification
            and resolution of issues.
        
    config DEBUG_VERBOSE
        bool "Enable verbose debugging output"
        default n
        help
            This option displays an excessive amount of additional logging information.

    config CONSOLE_STORE_HISTORY
        bool "Store command history in flash"
        default y
        help
            Linenoise line editing li rary provides functions to save and
            load command history. If this option is enabled, initialises a
            FAT filesystem and uses it to store command history.

    config CONSOLE_MAX_COMMAND_LINE_LENGTH
        int "Maximum command line length"
        default 1024
        help
            This value marks the maximum length of a single command line.
            Once it is reached, no more characters will be accepted by the
            console.

endmenu
```

## esp32_old/main/Kconfig.projbuild
```kconfig
menu "Wendigo Configuration"

    config DEFAULT_HOP_MILLIS
        int "Default dwell time for WiFi when channel hopping (milliseconds)"
        default 500
        help
            This specifies the default length of time Wendigo should remain on a
            wireless channel before progressing to the next channel when
            channel hopping is enabled.

    config BLE_SCAN_SECONDS
        int "Number of seconds for a single cycle of BLE scanning"
        default 10
        help
            This specifies the duration of BLE scanning. When this duration has passed
            Wendigo might dispatch a status update to Flipper Zero and restart scanning continually until
            scanning is deactivated. It's also possible data will be sent to Flipper Zero as soon as it is available.
            Who knows? :) But apart from a negligible performance impact this
            setting is mostly concerned with how frequently you would like a status update.
    
    config BT_SCAN_DURATION
        int "Duration of a Bluetooth Classic scan cycle"
        default 16
        help
            This specifies the duration of Bluetooth Classic Discovery, in 1.28-second units.
            When this duration has passed Gravity will display a status message and restart
            scanning continually until scanning is deactivated; apart from a negligible
            performance impact this setting is mostly concerned with how frequentnly you would
            like a status update.
            Developer's recommendation: 0x10 (16).

    config BLE_PURGE_MIN_AGE
        int "Do not automatically purge BLE devices seen within the specified number of seconds"
        default 30
        help
            BLE devices are pervasive and it is far from difficult to exhaust ESP32's memory by
            performing a BLE scan in a crowded area (a rough estimate has around 150 BLE devices
            filling ESP32's 4MB). To avoid the disruption this causes Gravity provides several
            approaches to automatically purge the least-interesting BLE devices; one of these is
            based on the time since the device was last seen.
            If enabled, age-based BLE purging will not remove any BLE devices seen within the
            specified number of seconds.

    config BLE_PURGE_MAX_RSSI
        int "Do not automatically purge BLE devices with an RSSI greater than this value"
        default -70
        help
            BLE devices are pervasive and it is far from difficult to exhaust ESP32's memory by
            performing a BLE scan in a crowded area (a rough estimate has around 150 BLE devices
            filling ESP32's 4MB). To avoid the disruption this causes Gravity provides several
            approaches to automatically purge the least-interesting BLE devices; one of these is
            based on the Received Signal Strength Indicator, or RSSI, of discovered devices.
            If enabled, RSSI-based BLE purging will not remove any BLE devices with an RSSI greater
            than the specified number. Remember that RSSI is a negative number; numbers closer to
            zero are better.

    config DECODE_UUIDS
        bool "Include Bluetooth UUID Dictionary"
        default y
        help
            Bluetooth services are represented by service UUIDs. Select this option to include
            Bluetooth assigned numbers details, allowing UUIDs to be translated into plain text.

    config DEBUG
        bool "Enable debugging output"
        default y
        help
            This option displays additional logging information to aid in the identification
            and resolution of issues.
        
    config DEBUG_VERBOSE
        bool "Enable verbose debugging output"
        default n
        help
            This option displays an excessive amount of additional logging information.

    config CONSOLE_STORE_HISTORY
        bool "Store command history in flash"
        default y
        help
            Linenoise line editing library provides functions to save and load
            command history. If this option is enabled, initalizes a FAT filesystem
            and uses it to store command history.

    config CONSOLE_MAX_COMMAND_LINE_LENGTH
        int "Maximum command line length"
        default 1024
        help
            This value marks the maximum length of a single command line. Once it is
            reached, no more characters will be accepted by the console.

endmenu
```
